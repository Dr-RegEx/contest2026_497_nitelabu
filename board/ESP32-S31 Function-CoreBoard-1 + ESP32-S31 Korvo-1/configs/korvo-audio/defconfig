## board/ESP32-S31 Function-CoreBoard-1 + ESP32-S31 Korvo-1/configs/korvo-audio/defconfig
```kconfig
#include "../xts-flat-rtc/defconfig"

# Korvo ES8389 standard PCM qualification, no real-media auto capture/save.
CONFIG_ESP32S31_BOARD_KORVO=y
# CONFIG_ESP32S31_BOARD_FUNCTION is not set
# CONFIG_ARCH_BUTTONS is not set
CONFIG_ESPRESSIF_I2C0=y
CONFIG_ESPRESSIF_I2C0_SCLPIN=1
CONFIG_ESPRESSIF_I2C0_SDAPIN=0
CONFIG_I2C_RESET=y
CONFIG_AUDIO=y
CONFIG_AUDIO_FORMAT_PCM=y
CONFIG_AUDIO_FORMAT_RAW=y
CONFIG_AUDIO_DRIVER_SPECIFIC_BUFFERS=y
CONFIG_ESP32S31_I2S=y
CONFIG_ESP32S31_I2S_DUPLEX=y
CONFIG_ESP32S31_KORVO_AUDIO=y
CONFIG_ESP32S31_KORVO_PCM_STOP_MS=2000
CONFIG_SYSTEM_NXLOOPER=y
CONFIG_NXLOOPER_MAINTHREAD_STACKSIZE=4096
CONFIG_NXLOOPER_LOOPTHREAD_STACKSIZE=4096
CONFIG_PTHREAD_STACK_MIN=4096
```

## board/ESP32-S31 Function-CoreBoard-1 + ESP32-S31 Korvo-1/configs/korvo-camera-touch-sd/defconfig
```kconfig
#include "../korvo-camera-touch/defconfig"
CONFIG_MMCSD=y
CONFIG_ARCH_HAVE_SDIO=y
CONFIG_MMCSD_SDIO=y
CONFIG_ESP32S31_SDMMC=y
CONFIG_ESP32S31_SDMMC_IDF_HOST=y
CONFIG_MMCSD_NSLOTS=1
CONFIG_FS_FAT=y
CONFIG_FS_FAT_LFN=y

CONFIG_NETUTILS_CODECS=y
CONFIG_CODECS_HASH_MD5=y
CONFIG_NSH_CMDOPT_HEXDUMP=y
CONFIG_DEBUG_FEATURES=y
CONFIG_DEBUG_ERROR=y
CONFIG_DEBUG_FS=y
CONFIG_DEBUG_FS_ERROR=y
```

## board/ESP32-S31 Function-CoreBoard-1 + ESP32-S31 Korvo-1/configs/korvo-mcpwm/defconfig
```kconfig
# MCPWM GPIO37 output/capture loopback on the onboard LED input.
#include "../xts-flat-rtc/defconfig"

CONFIG_ESP32S31_BOARD_KORVO=y
CONFIG_PWM=y
CONFIG_CAPTURE=y
CONFIG_ESP32S31_MCPWM=y
CONFIG_ESP32S31_MCPWM_PWM_PIN=37
CONFIG_ESP32S31_MCPWM_CAPTURE_PIN=37
CONFIG_ESP32S31_MCPWM_LOOPBACK_TEST=y
CONFIG_NSH_QUOTE=y
CONFIG_UART0_RXBUFSIZE=256
# CONFIG_NSH_ARGCAT is not set
# CONFIG_NSH_NETINIT is not set
# CONFIG_ESP_RMT is not set
CONFIG_ESP32S31_MCPWM_TRACE=y
```
