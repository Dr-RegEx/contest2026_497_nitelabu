## workspace/openvela-untracked/apps/examples/jpegtest/Kconfig
```kconfig
#
# JPEG/RGB software smoke test for the S31 board.
#

config EXAMPLES_JPEGTEST
	tristate "JPEG and RGB pixel-format test"
	default n
	depends on LIB_JPEG_TURBO
	---help---
		Enable the jpegtest command.  It encodes synthetic RGB888 images,
		checks decoded RGB888 pixels and RGB565 conversion, and rejects
		truncated inputs.  Optional width, height and repeat arguments
		exercise product sizes without camera capture or filesystem I/O.

if EXAMPLES_JPEGTEST

config EXAMPLES_JPEGTEST_PROGNAME
	string "Program name"
	default "jpegtest"

config EXAMPLES_JPEGTEST_PRIORITY
	int "Task priority"
	default 100

config EXAMPLES_JPEGTEST_STACKSIZE
	int "Task stack size"
	default 8192

endif
```

## workspace/openvela-untracked/apps/examples/s31digit/Kconfig
```kconfig
# SPDX-License-Identifier: Apache-2.0
config EXAMPLES_S31DIGIT
	tristate "S31 touchscreen handwritten digit recognition"
	default n
	depends on VIDEO_FB && FB_UPDATE && INPUT_TOUCHSCREEN

config EXAMPLES_S31DIGIT_SIMD
	bool "Use CPU1 PIE INT8 dot products"
	depends on EXAMPLES_S31DIGIT && ESP32S31_PIE
	default n
```

## workspace/openvela-untracked/apps/examples/s31fbcheck/Kconfig
```kconfig
# SPDX-License-Identifier: Apache-2.0
config EXAMPLES_S31FBCHECK
	tristate "S31 standard framebuffer qualification"
	default n
	depends on BUILD_KERNEL && SMP && VIDEO_FB && FB_UPDATE
	depends on ARCH_VMA_MAPPING
	help
		Verify synthetic pixels through two shared framebuffer mappings,
		standard file read/write and bounded display updates on one CPU.
		Use separate invocations to test both CPUs and process exit cleanup.
		No camera, audio, filesystem data or network connection is used.

if EXAMPLES_S31FBCHECK
config EXAMPLES_S31FBCHECK_STACKSIZE
	int "Main task stack size"
	default 16384
endif
```

## workspace/openvela-untracked/apps/examples/s31foundation/Kconfig
```kconfig
config EXAMPLES_S31FOUNDATION
	bool "S31 openvela foundation integration check"
	depends on FEATURE_FRAMEWORK && INTERPRETERS_QUICKJS && LIBUV
	depends on PROTOBUF_C && LIB_YOGA && LIB_PNG && LIB_FREETYPE
	depends on ESP32S31_KORVO_HMI_DATA || ESP32S31_KORVO_SMP_HMI_QUALIFICATION
	default n
	help
		Exercise actual JS/Feature/libuv, layout, serialization/storage,
		PNG and font APIs in the Korvo native HMI image. Synthetic data only;
		this does not run a quickapp or measure network/filesystem throughput.
```

## workspace/openvela-untracked/apps/examples/s31fsbench/Kconfig
```kconfig
config EXAMPLES_S31FSBENCH
	tristate "S31 committed filesystem numeric qualification"
	default n
	help
		Use standard stdio/POSIX calls for an 800000-byte file, separate
		setup/read/write/final-sync timing and complete data verification.
		Creates only safe-random.bin in an explicitly supplied directory;
		refuses to overwrite an existing file. This supplements original xTS.

if EXAMPLES_S31FSBENCH
config EXAMPLES_S31FSBENCH_STACKSIZE
	int "Task stack size"
	default 32768
endif
```

## workspace/openvela-untracked/apps/examples/s31keys/Kconfig
```kconfig
config EXAMPLES_S31KEYS
	tristate "S31 standard button device qualification"
	depends on INPUT_BUTTONS
	default n
	help
		Monitor /dev/buttons for a bounded number of seconds, then close it.
		Uses only standard button read/poll/ioctl APIs; no private ADC access.

if EXAMPLES_S31KEYS
config EXAMPLES_S31KEYS_STACKSIZE
	int "Task stack size"
	default 4096
endif
```

## workspace/openvela-untracked/apps/examples/s31mediacheck/Kconfig
```kconfig
config EXAMPLES_S31MEDIACHECK
	bool "S31 bounded synthetic MEDIA playback check"
	depends on MEDIA && MEDIA_SERVER && ESP32S31_KORVO_MEDIA
	depends on ESP32S31_FFMPEG_PSRAM_BSS || (BUILD_KERNEL && ARCH_ADDRENV && MM_PGALLOC)
	depends on FS_TMPFS
	default n
	help
		Generate a short low-amplitude stereo WAV at an exclusive new
		path (default /tmp), exercise the
		public Player API three times, and remove the owned file. No
		microphone, camera, network or business data is used. A completed
		MEDIA event is digital evidence, not human listening acceptance.
```

## workspace/openvela-untracked/apps/examples/s31pcmcheck/Kconfig
```kconfig
# SPDX-License-Identifier: Apache-2.0
config EXAMPLES_S31PCMCHECK
	tristate "S31 standard ALSA process lifecycle qualification"
	default n
	depends on BUILD_KERNEL && SMP && AUDIO_PROCESS_OWNERSHIP
	depends on ESP32S31_KORVO_AUDIO
	depends on AUDIOUTILS_ALSA_LIB && AUDIOUTILS_ALSA_LIB_DEVICE_HW
	help
		Play only generated PCM through public ALSA APIs. Check normal
		drain/close and prepared/playing/paused process exits on one CPU.
		No microphone, camera, file recording or network access.

if EXAMPLES_S31PCMCHECK
config EXAMPLES_S31PCMCHECK_STACKSIZE
	int "Main task stack size"
	default 16384
endif
```

## workspace/openvela-untracked/apps/examples/s31sdcheck/Kconfig
```kconfig
# SPDX-License-Identifier: Apache-2.0
config EXAMPLES_S31SDCHECK
	tristate "S31 bounded two-core VFS qualification"
	default n
	depends on SMP && !DISABLE_PTHREAD && !DISABLE_MOUNTPOINT
	help
		Check CPU affinity and two-thread synthetic file integrity through
		standard VFS calls. Creates a new owned directory, retains files for
		remount verification, and refuses unknown files during cleanup.
		This is a qualification tool, not a filesystem throughput benchmark.

if EXAMPLES_S31SDCHECK
config EXAMPLES_S31SDCHECK_STACKSIZE
	int "Main task stack size"
	default 16384
endif
```

## workspace/openvela-untracked/frameworks/runtimes/services/xmsdemo/factory/Kconfig
```kconfig
# SPDX-License-Identifier: Apache-2.0
config XMSDEMO_FACTORY
	tristate "ESP32-S31 Korvo native factory demo"
	default n
	depends on SYSTEM_SERVER && SYSTEM_ACTIVITY_SERVICE
	depends on SYSTEM_WINDOW_SERVICE && SYSTEM_PACKAGE_SERVICE
	depends on UIKIT && GRAPHICS_LVGL
	depends on LV_COLOR_DEPTH_16
	depends on LV_USE_CANVAS && LV_USE_IMAGE && LV_USE_LABEL
	depends on LV_USE_BUTTON && LV_USE_SLIDER && LV_USE_ROLLER && LV_USE_BAR
	depends on LV_USE_ARC && LV_USE_DROPDOWN && LV_USE_TEXTAREA
	depends on LV_USE_KEYBOARD && LV_USE_SPINBOX
	depends on LV_USE_THEME_SIMPLE
	depends on LV_FONT_MONTSERRAT_14 && LV_FONT_MONTSERRAT_18 && LV_FONT_MONTSERRAT_24 && LV_FONT_MONTSERRAT_46
	help
		Native Activity/Window port of the pinned Espressif factory demo.
		Requires native backend and coffee asset provider targets supplied by
		the platform integration. Does not configure hardware or ESP-IDF.
```

## workspace/openvela-untracked/frameworks/runtimes/services/xmsdemo/platform/Kconfig
```kconfig
config XMSDEMO_PLATFORM
	bool "Native platform product demo"
	depends on SYSTEM_SERVER && SYSTEM_ACTIVITY_SERVICE
	depends on SYSTEM_WINDOW_SERVICE && SYSTEM_PACKAGE_SERVICE_COMMAND
	depends on XMSDEMO_LVGLDEMO && UIKIT_FONT_MANAGER && KVDB
	default n
	help
		A native activity with live device/storage/network status,
		persistent appearance settings, and standard AM navigation.

config XMSDEMO_PLATFORM_MEDIA
	bool "Device demo audio controls"
	depends on XMSDEMO_PLATFORM && MEDIA && MEDIA_SERVER && MEDIA_GRAPH
	default n
	help
		Play a packaged synthetic tone through the public MEDIA Player API.
		One process-owned 8 KiB worker is reserved after first use; switching
		away closes the Player without blocking the activity/UI thread.
```

## workspace/openvela-untracked/nuttx/boards/risc-v/esp32s31/esp32s31-core-function-board/configs/function-ethernet/defconfig
```kconfig
#
# Initial ESP32-S31 Core Function Board bring-up configuration.
#
# CONFIG_NSH_ARGCAT is not set
# CONFIG_NSH_CMDOPT_HEXDUMP is not set
CONFIG_ARCH="risc-v"
CONFIG_ARCH_BOARD="esp32s31-core-function-board"
CONFIG_ARCH_BOARD_ESP32S31_CORE_FUNCTION_BOARD=y
CONFIG_ARCH_CHIP="esp32s31"
CONFIG_ARCH_CHIP_ESP32S31=y
CONFIG_ARCH_INTERRUPTSTACK=2048
CONFIG_ARCH_RISCV=y
CONFIG_BOARD_LOOPSPERMSEC=15000
CONFIG_BUILTIN=y
CONFIG_ESPRESSIF_CPU_FREQ_320=y
CONFIG_ESPRESSIF_ESP32S31=y
CONFIG_ESPRESSIF_FLASH_16M=y
CONFIG_ESPRESSIF_FLASH_FREQ_80M=y
CONFIG_ESPRESSIF_SIMPLE_BOOT=y
CONFIG_EXPERIMENTAL=y
CONFIG_FS_PROCFS=y
CONFIG_IDLETHREAD_STACKSIZE=2048
CONFIG_INIT_ENTRYPOINT="nsh_main"
CONFIG_INTELHEX_BINARY=y
CONFIG_LIBC_PERROR_STDOUT=y
CONFIG_LIBC_STRERROR=y
CONFIG_NFILE_DESCRIPTORS_PER_BLOCK=6
CONFIG_NSH_BUILTIN_APPS=y
CONFIG_NSH_FILEIOSIZE=512
CONFIG_NSH_READLINE=y
CONFIG_NSH_STRERROR=y
CONFIG_PREALLOC_TIMERS=0
CONFIG_RISCV_TOOLCHAIN_GNU_RV32=y
CONFIG_RR_INTERVAL=200
CONFIG_SCHED_WAITPID=y
CONFIG_START_DAY=11
CONFIG_START_MONTH=8
CONFIG_START_YEAR=2026
CONFIG_SYSTEM_NSH=y
CONFIG_ESPRESSIF_UART0_RXPIN=59
CONFIG_ESPRESSIF_UART0_TXPIN=58
CONFIG_UART0_SERIAL_CONSOLE=y
# CONFIG_ESPRESSIF_BROWNOUT_DET is not set

# Isolated native Function Ethernet profile; no Wi-Fi or AppFS.
CONFIG_BUILD_FLAT=y
CONFIG_ESP32S31_BOARD_FUNCTION=y
CONFIG_BOARD_LATE_INITIALIZE=y
CONFIG_SCHED_LPWORK=y
CONFIG_SCHED_LPWORKSTACKSIZE=4096
CONFIG_DEFAULT_TASK_STACKSIZE=4096
CONFIG_INIT_STACKSIZE=4096
CONFIG_NET=y
CONFIG_NET_ETHERNET=y
CONFIG_NET_IPv4=y
CONFIG_NET_ARP=y
CONFIG_NET_ICMP=y
CONFIG_NET_ICMP_SOCKET=y
CONFIG_NET_TCP=y
CONFIG_NET_TCP_WRITE_BUFFERS=y
CONFIG_NET_UDP=y
CONFIG_NET_STATISTICS=y
CONFIG_NETDEV_STATISTICS=y
CONFIG_NETDEV_IOCTL=y
CONFIG_NETDEV_PHY_IOCTL=y
CONFIG_NET_SOCKOPTS=y
CONFIG_NET_ETH_PKTSIZE=1514
CONFIG_NET_TCP_CONNS=8
CONFIG_NET_UDP_CONNS=8
CONFIG_NET_NACTIVESOCKETS=16
CONFIG_IOB_NBUFFERS=64
CONFIG_IOB_BUFSIZE=512
CONFIG_ESP32S31_EMAC=y
CONFIG_NSH_NETINIT=y
CONFIG_NETINIT_IPADDR=0xc0a85802
CONFIG_NETINIT_NETMASK=0xffffff00
CONFIG_NETINIT_DRIPADDR=0x00000000
CONFIG_SYSTEM_PING=y
CONFIG_SYSTEM_PING_STACKSIZE=4096
CONFIG_NETUTILS_IPERF=y
CONFIG_NETUTILS_IPERF_STACKSIZE=4096
CONFIG_SYSTEM_STACKMONITOR=y
CONFIG_SYSTEM_STACKMONITOR_STACKSIZE=2048
CONFIG_STACK_COLORATION=y
# CONFIG_NETINIT_DHCPC is not set
# CONFIG_ESPRESSIF_WIFI is not set
# CONFIG_ESPRESSIF_SPIRAM is not set
# CONFIG_NETINIT_THREAD is not set
CONFIG_LIBC_UNAME_DISABLE_TIMESTAMP=y
```
